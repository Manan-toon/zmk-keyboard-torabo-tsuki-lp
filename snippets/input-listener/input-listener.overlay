&pointing_listener {
    status = "okay";
    device = <&pointing_device>;

    // カーソル移動: XY反転（右ボール実装向け）→ 1.5倍速（据え置き）
    input-processors =
        <&zip_xy_transform (INPUT_TRANSFORM_X_INVERT | INPUT_TRANSFORM_Y_INVERT)>,
        <&zip_xy_scaler 3 2>;

    // スクロール: 縦だけ反転、横(X)は据え置き
    scroller {
        layers = <3>;
        input-processors =
            <&zip_xy_transform (INPUT_TRANSFORM_X_INVERT)>,
            <&zip_xy_to_scroll_mapper>,
            <&zip_scroll_scaler 1 8>;
    };
};
